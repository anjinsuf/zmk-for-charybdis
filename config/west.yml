## config/west.yml
```yaml
manifest:
  remotes:
    - name: zmkfirmware
      url-base: https://github.com/DoctorWangWang

  projects:
    - name: zmk
      remote: zmkfirmware
      revision: feature-test
      import: app/west.yml

    - name: zmk-pmw3610-driver
      remote: zmkfirmware
      revision: main

  self:
    path: config
```
